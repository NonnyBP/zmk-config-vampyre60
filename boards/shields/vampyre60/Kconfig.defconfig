## boards/shields/vampyre60/Kconfig.defconfig
```kconfig
if SHIELD_VAMPYRE60_LEFT

config ZMK_KEYBOARD_NAME
    default "vampyre60"

config ZMK_SPLIT_ROLE_CENTRAL
    default y

endif


if SHIELD_VAMPYRE60_LEFT || SHIELD_VAMPYRE60_RIGHT

config ZMK_SPLIT
    default y

endif
```

## boards/shields/vampyre60/Kconfig.shield
```kconfig
config SHIELD_VAMPYRE60_LEFT
    def_bool $(shields_list_contains,vampyre60_left)

config SHIELD_VAMPYRE60_RIGHT
    def_bool $(shields_list_contains,vampyre60_right)

config SHIELD_VAMPYRE60_DONGLE
    def_bool $(shields_list_contains,vampyre60_dongle)
```
